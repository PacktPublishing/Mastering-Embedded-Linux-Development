## Chapter11/meta-device-drivers/conf/layer.conf
```bitbake
# We have a conf and classes directory, add to BBPATH
BBPATH .= ":${LAYERDIR}"

# We have recipes-* directories, add to BBFILES
BBFILES += "${LAYERDIR}/recipes-*/*/*.bb \
            ${LAYERDIR}/recipes-*/*/*.bbappend"

BBFILE_COLLECTIONS += "device-drivers"
BBFILE_PATTERN_device-drivers = "^${LAYERDIR}/"
BBFILE_PRIORITY_device-drivers = "6"

LAYERDEPENDS_device-drivers = "core"
LAYERSERIES_COMPAT_device-drivers = "scarthgap"
```

## Chapter11/meta-user-space/conf/layer.conf
```bitbake
# We have a conf and classes directory, add to BBPATH
BBPATH .= ":${LAYERDIR}"

# We have recipes-* directories, add to BBFILES
BBFILES += "${LAYERDIR}/recipes-*/*/*.bb \
            ${LAYERDIR}/recipes-*/*/*.bbappend"

BBFILE_COLLECTIONS += "user-space"
BBFILE_PATTERN_user-space = "^${LAYERDIR}/"
BBFILE_PRIORITY_user-space = "6"

LAYERDEPENDS_user-space = "core"
LAYERSERIES_COMPAT_user-space = "scarthgap"
```

## Chapter19/buildroot/package/mbx-driver-oops/Config.in
```kconfig
config BR2_PACKAGE_MBX_DRIVER_OOPS
	bool "mbx_driver_oops"
	depends on BR2_LINUX_KERNEL
```

## Chapter19/meta-mbx-driver/conf/layer.conf
```bitbake
# We have a conf and classes directory, add to BBPATH
BBPATH .= ":${LAYERDIR}"

# We have recipes-* directories, add to BBFILES
BBFILES += "${LAYERDIR}/recipes-*/*/*.bb \
            ${LAYERDIR}/recipes-*/*/*.bbappend"

BBFILE_COLLECTIONS += "mbx-driver"
BBFILE_PATTERN_mbx-driver = "^${LAYERDIR}/"
BBFILE_PRIORITY_mbx-driver = "6"

LAYERDEPENDS_mbx-driver = "core"
LAYERSERIES_COMPAT_mbx-driver = "scarthgap"
```

## Chapter20/buildroot/package/ebpf/Config.in
```kconfig
config BR2_PACKAGE_EBPF
	bool "ebpf"
	select BR2_PACKAGE_DROPBEAR
	select BR2_PACKAGE_TMUX
	select BR2_PACKAGE_VIM
	select BR2_PACKAGE_BPFTOOL
	select BR2_PACKAGE_PLY
	select BR2_PACKAGE_REDIS
	help
	  An image overlay that includes ply for dynamic tracing
```
